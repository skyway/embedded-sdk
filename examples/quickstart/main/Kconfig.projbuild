## examples/quickstart/main/Kconfig.projbuild
```kconfig
menu "SkyWay Quickstart Configuration"

    config SKYWAY_QUICKSTART_WIFI_SSID
        string "WiFi SSID"
        default "myssid"
        help
            SSID of the access point to connect to.

    config SKYWAY_QUICKSTART_WIFI_PASSWORD
        string "WiFi Password"
        default "mypassword"
        help
            Password of the access point. Leave empty for an open network.

    config SKYWAY_QUICKSTART_APP_ID
        string "SkyWay AppID"
        default "app-id"
        help
            Application ID issued by the SkyWay console.

    config SKYWAY_QUICKSTART_SECRET_KEY
        string "SkyWay SecretKey"
        default "secret-key"
        help
            Secret key issued by the SkyWay console. For development use only.

    config SKYWAY_QUICKSTART_ROOM_NAME
        string "Room name"
        default "skyway-quickstart"
        help
            Name of the room to join. Up to 128 characters.

    config SKYWAY_QUICKSTART_MEMBER_NAME
        string "Member name"
        default "esp32"
        help
            Name of this device in the room. Up to 128 characters.

endmenu
```

## examples/quickstart/sdkconfig.defaults
```kconfig
CONFIG_FREERTOS_HZ=1000
CONFIG_FREERTOS_SUPPORT_STATIC_ALLOCATION=y
CONFIG_SPIRAM=y
CONFIG_SPIRAM_ALLOW_BSS_SEG_EXTERNAL_MEMORY=y
CONFIG_MBEDTLS_SSL_PROTO_DTLS=y
CONFIG_MBEDTLS_SSL_DTLS_SRTP=y
CONFIG_MBEDTLS_CERTIFICATE_BUNDLE=y
CONFIG_WS_BUFFER_SIZE=6144
CONFIG_MBEDTLS_EXTERNAL_MEM_ALLOC=y
CONFIG_SPIRAM_MALLOC_ALWAYSINTERNAL=8192
CONFIG_PARTITION_TABLE_CUSTOM=y
CONFIG_PARTITION_TABLE_CUSTOM_FILENAME="partitions.csv"
CONFIG_ESPTOOLPY_FLASHSIZE_8MB=y
CONFIG_ESPTOOLPY_FLASHSIZE="8MB"
```

## examples/quickstart/sdkconfig.defaults.esp32p4
```kconfig
# ESP32-P4向けの設定。
# ESP32-P4はWi-Fiを内蔵しないため、Wi-Fiコプロセッサ（ESP32-C6等）をesp_hosted経由で使う。
# コプロセッサとの接続方式やピン配置はボードごとに異なる。既定値で接続できない場合は
# menuconfigの「Component config > ESP-Hosted config」でボードの回路に合わせること。
CONFIG_ESPTOOLPY_FLASHSIZE_16MB=y
CONFIG_ESPTOOLPY_FLASHSIZE="16MB"
CONFIG_IDF_EXPERIMENTAL_FEATURES=y
CONFIG_SPIRAM_SPEED_200M=y
CONFIG_CACHE_L2_CACHE_128KB=y
CONFIG_CACHE_L2_CACHE_LINE_64B=y
```

## examples/quickstart/sdkconfig.defaults.esp32s3
```kconfig
# ESP32-S3向けの設定。PSRAMを8MB以上（Octal SPI）搭載したモジュールを前提とする。
# PSRAMが8MB未満のモジュールではメモリが不足するため利用できない。
CONFIG_SPIRAM_MODE_OCT=y
CONFIG_SPIRAM_SPEED_80M=y
CONFIG_ESP_DEFAULT_CPU_FREQ_MHZ_240=y
```
